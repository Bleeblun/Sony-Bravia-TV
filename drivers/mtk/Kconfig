## drivers/mtk/Kconfig
```kconfig
menu "MediaTek MT53XX Series Support"

config MT5396_DRIVERS
        tristate "MT5396 drivers support"
        default n
        depends on ARCH_MT5396
        help
          Include all the mt5396 drivers.

config MT5368_DRIVERS
        tristate "MT5368 drivers support"
        default n
        depends on ARCH_MT5368
        help
          Include all the mt5368 drivers.

config MT5389_DRIVERS
        tristate "MT5389 drivers support"
        default n
        depends on ARCH_MT5389
        help
          Include all the mt5389 drivers.

config MT5398_DRIVERS
        tristate "MT5398 drivers support"
        default n
        depends on ARCH_MT5398
        help
          Include all the mt5398 drivers.

config MT5399_DRIVERS
        tristate "MT5399 drivers support"
        default n
        depends on ARCH_MT5399
        help
          Include all the mt5399 drivers.

config MT5880_DRIVERS
        tristate "MT5398 drivers support"
        default n
        depends on ARCH_MT5880
        help
          Include all the mt5880 drivers.
          
config MT5881_DRIVERS
        tristate "MT5881 drivers support"
        default n
        depends on ARCH_MT5881
        help
          Include all the mt5881 drivers.

config MT5890_DRIVERS
        tristate "MT5890 drivers support"
        default n
        depends on ARCH_MT5890
        help
          Include all the mt5890 drivers.
          
config MT5882_DRIVERS
        tristate "MT5882 drivers support"
        default n
        depends on ARCH_MT5882
        help
          Include all the mt5882 drivers.
endmenu
```
